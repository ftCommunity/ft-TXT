## package/python-pycairo/Config.in
```kconfig
config BR2_PACKAGE_PYTHON_PYCAIRO
	bool "python-pycairo"
	select BR2_PACKAGE_CAIRO
	select BR2_PACKAGE_PYTHON_XPYB
	depends on BR2_PACKAGE_PYTHON || BR2_PACKAGE_PYTHON3
	help
	  Python bindings for cairo

	  http://www.cairographics.org/pycairo
```
